## arch/arm/mach-tegra/tegra210/Kconfig
```kconfig
if TEGRA210

choice
	prompt "Tegra210 board select"

config TARGET_P2571_E01
	bool "NVIDIA Tegra210 P2571 reference board (E.1)"

endchoice

config SYS_SOC
	default "tegra210"

source "board/nvidia/p2571-e01/Kconfig"

endif
```

## configs/p2371-e01_defconfig
```kconfig
CONFIG_ARM=y
CONFIG_TEGRA=y
CONFIG_TEGRA210=y
CONFIG_TARGET_P2371_E01=y
CONFIG_DEFAULT_DEVICE_TREE="tegra210-p2371-e01"
# CONFIG_CMD_IMI is not set
# CONFIG_CMD_IMLS is not set
# CONFIG_CMD_FLASH is not set
# CONFIG_CMD_FPGA is not set
# CONFIG_CMD_SETEXPR is not set
# CONFIG_CMD_NFS is not set
CONFIG_SPI_FLASH=y
CONFIG_USB=y
CONFIG_DM_USB=y
```
